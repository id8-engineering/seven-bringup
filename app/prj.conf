## CMakeLists.txt
```
# Copyright (c) 2026 ID8 Engineering AB
# SPDX-License-Identifier: Apache-2.0

cmake_minimum_required(VERSION 3.20.0)

find_package(Zephyr REQUIRED HINTS $ENV{ZEPHYR_BASE})

project(app LANGUAGES C)

target_sources(app PRIVATE
  src/main.c
  src/gnss.c
  src/led_rbg.c
  src/buzzer.c
  src/lte.c
  src/gpio.c
  src/mikroBUS_sensor.c
  src/mikroBUS_CAN.c
  src/mikroBUS_pwm.c
  src/mikroBUS_adc.c
)
```

## Kconfig
```
# Copyright (c) 2026 ID8 Engineering AB
# SPDX-License-Identifier: Apache-2.0

source "Kconfig.zephyr"

menu "Seven bringup tests"

config SEVEN_TEST_LED
	bool "Test RGB LED"

config SEVEN_TEST_BUZZER
	bool "Test buzzer"

config SEVEN_TEST_GPIO_MIKROBUS
  bool "Test GPIOs mikroBUS"

config SEVEN_TEST_I2C_MIKROBUS
	bool "Test mikroBUS I2C"

config SEVEN_TEST_CAN_MIKROBUS
	bool "Test mikroBUS CAN"

config SEVEN_TEST_PWM_MIKROBUS
	bool "Test mikroBUS PWM"

config SEVEN_TEST_AN_MIKROBUS
	bool "Test mikroBUS AN"

config SEVEN_TEST_GNSS
	bool "Test GNSS"

config SEVEN_TEST_LTE
	bool "Test LTE"

endmenu
```

## prj.conf
```kconfig
# Use log
CONFIG_LOG=y
CONFIG_CBPRINTF_FP_SUPPORT=y

# LED driver
CONFIG_LED_STRIP=y
CONFIG_WS2812_STRIP_SPI=y

# Buzzer driver
CONFIG_PWM=y
CONFIG_ADC=y

# Clicker board hts221 driver
CONFIG_I2C=y
CONFIG_SENSOR=y
CONFIG_HTS221=y

# Clicker board MCP2515 CAN driver
CONFIG_CAN=y

# Modem
CONFIG_NRF_MODEM_LIB=y
CONFIG_LTE_LINK_CONTROL=y

# GNSS
CONFIG_LTE_NETWORK_MODE_LTE_M_GPS=y
CONFIG_LTE_NETWORK_MODE_NBIOT_GPS=n
CONFIG_LTE_NETWORK_MODE_LTE_M_NBIOT_GPS=n
CONFIG_MODEM_ANTENNA=y
CONFIG_MODEM_ANTENNA_GNSS_EXTERNAL=y

# Tests
CONFIG_SEVEN_TEST_LED=y
CONFIG_SEVEN_TEST_BUZZER=n
CONFIG_SEVEN_TEST_GPIO_MIKROBUS=n
CONFIG_SEVEN_TEST_I2C_MIKROBUS=n
CONFIG_SEVEN_TEST_CAN_MIKROBUS=n
CONFIG_SEVEN_TEST_PWM_MIKROBUS=n
CONFIG_SEVEN_TEST_AN_MIKROBUS=n
CONFIG_SEVEN_TEST_GNSS=n
CONFIG_SEVEN_TEST_LTE=n

CONFIG_AT_HOST_LIBRARY=y
```

## boards/seven_nrf9151_ns.overlay
```dts
/*
 * SPDX-FileCopyrightText: 2026 ID8 Engineering AB
 *
 * SPDX-License-Identifier: Apache-2.0
 */

/* / { */
/* 	zephyr,user { */
/* 		io-channels = <&adc 0>, <&adc 1>; */
/* 		io-channel-names = "mikrobus_1_an", "mikrobus_2_an"; */
/* 	}; */
/* }; */

/ {
  chosen {
    ncs,at-host-uart = &uart3;
  };
};

&uart3 {
	status = "okay";
	current-speed = <115200>;
};

/* #include <zephyr/dt-bindings/pwm/pwm.h> */
/**/
/* / { */
/* 	pwmleds { */
/* 		compatible = "pwm-leds"; */
/**/
/* 		mikrobus_pwm: mikrobus_pwm { */
/* 			pwms = <&pwm0 0 PWM_MSEC(1) PWM_POLARITY_NORMAL>; */
/* 		}; */
/* 	}; */
/* }; */
/**/
/* &pwm0 { */
/* 	status = "okay"; */
/* 	pinctrl-0 = <&mikrobus_1_pwm_default>; */
/* 	pinctrl-names = "default"; */
/* }; */

/* &mikrobus_i2c { */
/* 	status = "okay"; */
/**/
/* 	hts221@5f { */
/* 		compatible = "st,hts221"; */
/* 		reg = <0x5f>; */
/* 		status = "okay"; */
/* 	}; */
/* }; */

/* &mikrobus_spi { */
/* 	status = "okay"; */
/* 	cs-gpios = <&mikrobus_header 2 GPIO_ACTIVE_LOW>; */
/**/
/* 	can0: can@0 { */
/* 		compatible = "microchip,mcp2515"; */
/* 		reg = <0>; */
/* 		spi-max-frequency = <10000000>; */
/* 		int-gpios = <&mikrobus_header 7 GPIO_ACTIVE_LOW>; */
/* 		osc-freq = <10000000>; */
/* 		status = "okay"; */
/* 	}; */
/* }; */
/**/
/* / { */
/* 	chosen { */
/* 		zephyr,canbus = &can0; */
/* 	}; */
/* }; */
```

## src/main.c
```c
// Copyright (c) 2026 ID8 Engineering AB
// SPDX-License-Identifier: Apache-2.0

#include <zephyr/kernel.h>
#include <zephyr/logging/log.h>

#include <modem/nrf_modem_lib.h>

#include "buzzer.h"
#include "gnss.h"
#include "led_rbg.h"
#include "lte.h"
#include "gpio.h"
#include "mikroBUS_adc.h"
#include "mikroBUS_CAN.h"
#include "mikroBUS_pwm.h"
#include "mikroBUS_sensor.h"

LOG_MODULE_REGISTER(main, LOG_LEVEL_INF);

int main(void)
{
	int err;

	if (IS_ENABLED(CONFIG_NRF_MODEM_LIB)) {
		err = nrf_modem_lib_init();
		if (err) {
			LOG_ERR("Modem library initialization failed: %d", err);
			return 0;
		}
	}

	if (IS_ENABLED(CONFIG_SEVEN_TEST_LED)) {
		test_led();
	}

	if (IS_ENABLED(CONFIG_SEVEN_TEST_BUZZER)) {
		test_buzzer();
	}
	if (IS_ENABLED(CONFIG_SEVEN_TEST_GPIO_MIKROBUS)) {
		test_gpio();
	}

	if (IS_ENABLED(CONFIG_SEVEN_TEST_I2C_MIKROBUS)) {
		test_mikroBUS_I2C();
	}

	if (IS_ENABLED(CONFIG_SEVEN_TEST_CAN_MIKROBUS)) {
		test_mikroBUS_CAN();
	}

	if (IS_ENABLED(CONFIG_SEVEN_TEST_PWM_MIKROBUS)) {
		test_mikroBUS_pwm();
	}

	if (IS_ENABLED(CONFIG_SEVEN_TEST_AN_MIKROBUS)) {
		test_mikroBUS_adc();
	}

	if (IS_ENABLED(CONFIG_SEVEN_TEST_GNSS)) {
		test_gnss();
	}

	if (IS_ENABLED(CONFIG_SEVEN_TEST_LTE)) {
		test_lte();
	}

	return 0;
}
```

## src/buzzer.c
```c
// Copyright (c) 2026 ID8 Engineering AB
// SPDX-License-Identifier: Apache-2.0

#include <zephyr/kernel.h>
#include <zephyr/device.h>
#include <zephyr/drivers/pwm.h>
#include <zephyr/logging/log.h>

LOG_MODULE_REGISTER(buzzer, LOG_LEVEL_INF);

static const struct pwm_dt_spec buzzer = PWM_DT_SPEC_GET(DT_NODELABEL(buzzer));

static int play_tone(uint32_t freq_hz, uint32_t duration_ms)
{
	if (!pwm_is_ready_dt(&buzzer)) {
		return -ENODEV;
	}

	uint32_t period_ns = 1000000000U / freq_hz;
	uint32_t pulse_ns = period_ns / 2;

	int ret = pwm_set_dt(&buzzer, period_ns, pulse_ns);
	if (ret < 0) {
		LOG_ERR("pwm_set_dt start failed: ret=%d", ret);
		return ret;
	}

	k_sleep(K_MSEC(duration_ms));

	ret = pwm_set_dt(&buzzer, period_ns, 0);
	if (ret < 0) {
		LOG_ERR("pwm_set_dt stop failed: ret=%d", ret);
		return ret;
	}

	return 0;
}

void test_buzzer()
{
	LOG_INF("Running buzzer test");
	LOG_INF("...");
	play_tone(659, 125); /* E5 */
	k_sleep(K_MSEC(125));
	play_tone(659, 125); /* E5 */
	k_sleep(K_MSEC(250));
	play_tone(659, 125); /* E5 */
	k_sleep(K_MSEC(250));
	play_tone(523, 125); /* C5 */
	k_sleep(K_MSEC(125));
	play_tone(659, 125); /* E5 */
	k_sleep(K_MSEC(250));
	play_tone(784, 125); /* G5 */
	k_sleep(K_MSEC(625));
	play_tone(392, 125); /* G4 */
	k_sleep(K_MSEC(625));

	play_tone(523, 125); /* C5 */
	k_sleep(K_MSEC(375));
	play_tone(392, 125); /* G4 */
	k_sleep(K_MSEC(375));
	play_tone(330, 125); /* E4 */
	k_sleep(K_MSEC(375));
	play_tone(440, 125); /* A4 */
	k_sleep(K_MSEC(250));
	play_tone(494, 125); /* B4 */
	k_sleep(K_MSEC(250));
	play_tone(466, 125); /* Bb4 */
	k_sleep(K_MSEC(125));
	play_tone(440, 125); /* A4 */
	k_sleep(K_MSEC(250));

	play_tone(392, 100); /* G4 */
	k_sleep(K_MSEC(100));
	play_tone(659, 100); /* E5 */
	k_sleep(K_MSEC(100));
	play_tone(784, 100); /* G5 */
	k_sleep(K_MSEC(100));
	play_tone(880, 125); /* A5 */
	k_sleep(K_MSEC(250));
	play_tone(698, 125); /* F5 */
	k_sleep(K_MSEC(125));
	play_tone(784, 125); /* G5 */
	k_sleep(K_MSEC(125));
	play_tone(659, 125); /* E5 */
	k_sleep(K_MSEC(125));
	play_tone(523, 125); /* C5 */
	k_sleep(K_MSEC(125));
	play_tone(587, 125); /* D5 */
	k_sleep(K_MSEC(125));
	play_tone(494, 125); /* B4 */
	k_sleep(K_MSEC(375));
  LOG_INF("Buzzer test over");
}
```

## src/buzzer.h
```c
// Copyright (c) 2026 ID8 Engineering AB
// SPDX-License-Identifier: Apache-2.0

#ifndef BUZZER_H_
#define BUZZER_H_

void test_buzzer(void);

#endif /* BUZZER_H_ */
```

## src/gnss.c
```c
// Copyright (c) 2026 ID8 Engineering AB
// SPDX-License-Identifier: Apache-2.0

#include <zephyr/kernel.h>
#include <zephyr/logging/log.h>

#include <modem/lte_lc.h>
#include <modem/nrf_modem_lib.h>
#include <nrf_modem_gnss.h>

#include "gnss.h"

LOG_MODULE_REGISTER(GNSS, LOG_LEVEL_INF);

static struct k_sem fix_sem;
static struct nrf_modem_gnss_pvt_data_frame last_pvt;

static void gnss_event_handler(int event)
{
	int err;
	uint8_t tracked = 0;
	uint8_t in_fix = 0;

	switch (event) {
	case NRF_MODEM_GNSS_EVT_PVT:
		err = nrf_modem_gnss_read(&last_pvt, sizeof(last_pvt), NRF_MODEM_GNSS_DATA_PVT);
		if (err == 0) {
			for (int i = 0; i < NRF_MODEM_GNSS_MAX_SATELLITES; i++) {
				if (last_pvt.sv[i].sv > 0) {
					tracked++;
				}
				if (last_pvt.sv[i].flags & NRF_MODEM_GNSS_SV_FLAG_USED_IN_FIX) {
					in_fix++;
				}
			}

			LOG_INF("PVT: tracked=%u used=%u fix=%s", tracked, in_fix,
				(last_pvt.flags & NRF_MODEM_GNSS_PVT_FLAG_FIX_VALID) ? "yes"
										     : "no");

			if (last_pvt.flags & NRF_MODEM_GNSS_PVT_FLAG_FIX_VALID) {
				LOG_INF("GNSS fix: lat=%.06f lon=%.06f acc=%.01f m",
					last_pvt.latitude, last_pvt.longitude,
					(double)last_pvt.accuracy);
				k_sem_give(&fix_sem);
				LOG_INF("GNSS Test done");
			}
		}
		break;

	case NRF_MODEM_GNSS_EVT_FIX:
		LOG_INF("GNSS fix event");
		k_sem_give(&fix_sem);
		break;

	default:
		break;
	}
}

void test_gnss(void)
{
	int err;

	k_sem_init(&fix_sem, 0, 1);

	LOG_INF("Running GNSS test");
	LOG_INF("...");

	err = nrf_modem_lib_init();
	if (err < 0) {
		LOG_ERR("Modem init failed: %d", err);
		return;
	}

	err = lte_lc_func_mode_set(LTE_LC_FUNC_MODE_ACTIVATE_GNSS);
	if (err < 0) {
		LOG_ERR("Failed to activate GNSS: %d", err);
		return;
	}

	err = nrf_modem_gnss_event_handler_set(gnss_event_handler);
	if (err < 0) {
		LOG_ERR("Failed to set GNSS event handler: %d", err);
		return;
	}

	err = nrf_modem_gnss_nmea_mask_set(
		NRF_MODEM_GNSS_NMEA_RMC_MASK | NRF_MODEM_GNSS_NMEA_GGA_MASK |
		NRF_MODEM_GNSS_NMEA_GLL_MASK | NRF_MODEM_GNSS_NMEA_GSA_MASK |
		NRF_MODEM_GNSS_NMEA_GSV_MASK);
	if (err < 0) {
		LOG_ERR("Failed to set GNSS NMEA mask: %d", err);
		return;
	}

	err = nrf_modem_gnss_use_case_set(NRF_MODEM_GNSS_USE_CASE_MULTIPLE_HOT_START);
	if (err < 0) {
		LOG_ERR("Failed to set GNSS use case: %d", err);
		return;
	}

	err = nrf_modem_gnss_fix_retry_set(0);
	if (err < 0) {
		LOG_ERR("Failed to set GNSS fix retry: %d", err);
		return;
	}

	err = nrf_modem_gnss_fix_interval_set(1);
	if (err < 0) {
		LOG_ERR("Failed to set GNSS fix interval: %d", err);
		return;
	}

	err = nrf_modem_gnss_start();
	if (err < 0) {
		LOG_ERR("Failed to start GNSS: %d", err);
		return;
	}

	LOG_INF("GNSS started, waiting for fix");

	if (k_sem_take(&fix_sem, K_MINUTES(10)) != 0) {
		LOG_WRN("GNSS fix timeout");
	}

	(void)nrf_modem_gnss_stop();
}
```

## src/gnss.h
```c
// Copyright (c) 2026 ID8 Engineering AB
// SPDX-License-Identifier: Apache-2.0

#ifndef GNSS_H_
#define GNSS_H_

void test_gnss(void);

#endif /* GNSS_H_ */
```

## src/gpio.c
```c
#include <zephyr/kernel.h>
#include <zephyr/device.h>
#include <zephyr/drivers/gpio.h>
#include <zephyr/logging/log.h>
#include <zephyr/sys/util.h>

LOG_MODULE_REGISTER(gpio, LOG_LEVEL_INF);

static const struct gpio_dt_spec mikrobus1[] = {
	{.port = DEVICE_DT_GET(DT_NODELABEL(gpio0)),
	 .pin = 14,
	 .dt_flags = GPIO_ACTIVE_HIGH}, /* AN */
	{.port = DEVICE_DT_GET(DT_NODELABEL(gpio0)),
	 .pin = 2,
	 .dt_flags = GPIO_ACTIVE_HIGH}, /* RST */
	{.port = DEVICE_DT_GET(DT_NODELABEL(gpio0)),
	 .pin = 0,
	 .dt_flags = GPIO_ACTIVE_HIGH}, /* CS */
	{.port = DEVICE_DT_GET(DT_NODELABEL(gpio0)),
	 .pin = 6,
	 .dt_flags = GPIO_ACTIVE_HIGH}, /* SCK */
	{.port = DEVICE_DT_GET(DT_NODELABEL(gpio0)),
	 .pin = 5,
	 .dt_flags = GPIO_ACTIVE_HIGH}, /* MISO */
	{.port = DEVICE_DT_GET(DT_NODELABEL(gpio0)),
	 .pin = 4,
	 .dt_flags = GPIO_ACTIVE_HIGH}, /* MOSI */
	{.port = DEVICE_DT_GET(DT_NODELABEL(gpio0)),
	 .pin = 3,
	 .dt_flags = GPIO_ACTIVE_HIGH}, /* PWM */
	{.port = DEVICE_DT_GET(DT_NODELABEL(gpio0)),
	 .pin = 1,
	 .dt_flags = GPIO_ACTIVE_HIGH}, /* INT */
	{.port = DEVICE_DT_GET(DT_NODELABEL(gpio0)),
	 .pin = 11,
	 .dt_flags = GPIO_ACTIVE_HIGH}, /* RX */
	{.port = DEVICE_DT_GET(DT_NODELABEL(gpio0)),
	 .pin = 10,
	 .dt_flags = GPIO_ACTIVE_HIGH}, /* TX */
	{.port = DEVICE_DT_GET(DT_NODELABEL(gpio0)),
	 .pin = 8,
	 .dt_flags = GPIO_ACTIVE_HIGH}, /* SCL */
	{.port = DEVICE_DT_GET(DT_NODELABEL(gpio0)),
	 .pin = 9,
	 .dt_flags = GPIO_ACTIVE_HIGH}, /* SDA */
};

static const struct gpio_dt_spec mikrobus2[] = {
	{.port = DEVICE_DT_GET(DT_NODELABEL(gpio0)),
	 .pin = 20,
	 .dt_flags = GPIO_ACTIVE_HIGH}, /* AN */
	{.port = DEVICE_DT_GET(DT_NODELABEL(gpio0)),
	 .pin = 16,
	 .dt_flags = GPIO_ACTIVE_HIGH}, /* RST */
	{.port = DEVICE_DT_GET(DT_NODELABEL(gpio0)),
	 .pin = 7,
	 .dt_flags = GPIO_ACTIVE_HIGH}, /* CS */
	{.port = DEVICE_DT_GET(DT_NODELABEL(gpio0)),
	 .pin = 29,
	 .dt_flags = GPIO_ACTIVE_HIGH}, /* SCK */
	{.port = DEVICE_DT_GET(DT_NODELABEL(gpio0)),
	 .pin = 28,
	 .dt_flags = GPIO_ACTIVE_HIGH}, /* MISO */
	{.port = DEVICE_DT_GET(DT_NODELABEL(gpio0)),
	 .pin = 21,
	 .dt_flags = GPIO_ACTIVE_HIGH}, /* MOSI */
	{.port = DEVICE_DT_GET(DT_NODELABEL(gpio0)),
	 .pin = 17,
	 .dt_flags = GPIO_ACTIVE_HIGH}, /* PWM */
	{.port = DEVICE_DT_GET(DT_NODELABEL(gpio0)),
	 .pin = 15,
	 .dt_flags = GPIO_ACTIVE_HIGH}, /* INT */
	{.port = DEVICE_DT_GET(DT_NODELABEL(gpio0)),
	 .pin = 13,
	 .dt_flags = GPIO_ACTIVE_HIGH}, /* RX */
	{.port = DEVICE_DT_GET(DT_NODELABEL(gpio0)),
	 .pin = 12,
	 .dt_flags = GPIO_ACTIVE_HIGH}, /* TX */
	{.port = DEVICE_DT_GET(DT_NODELABEL(gpio0)),
	 .pin = 23,
	 .dt_flags = GPIO_ACTIVE_HIGH}, /* SCL */
	{.port = DEVICE_DT_GET(DT_NODELABEL(gpio0)),
	 .pin = 22,
	 .dt_flags = GPIO_ACTIVE_HIGH}, /* SDA */
};

static void configure_gpio(void)
{
	for (size_t i = 0; i < ARRAY_SIZE(mikrobus1); i++) {
		gpio_pin_configure_dt(&mikrobus1[i], GPIO_OUTPUT_INACTIVE);
	}

	for (size_t i = 0; i < ARRAY_SIZE(mikrobus2); i++) {
		gpio_pin_configure_dt(&mikrobus2[i], GPIO_OUTPUT_INACTIVE);
	}
}

void test_gpio(void)
{
	LOG_INF("Running GPIO test");
	configure_gpio();

	while (1) {
		for (size_t i = 0; i < ARRAY_SIZE(mikrobus1); i++) {
			gpio_pin_set_dt(&mikrobus1[i], 1);
			gpio_pin_set_dt(&mikrobus2[i], 1);

			k_sleep(K_MSEC(500));

			gpio_pin_set_dt(&mikrobus1[i], 0);
			gpio_pin_set_dt(&mikrobus2[i], 0);
		}
	}
}
```

## src/gpio.h
```c
// Copyright (c) 2026 ID8 Engineering AB
// SPDX-License-Identifier: Apache-2.0

#ifndef GPIO_H_
#define GPIO_H_

void test_gpio(void);

#endif /* GPIO_H_ */
```

## src/led_rbg.c
```c
// Copyright (c) 2026 ID8 Engineering AB
// SPDX-License-Identifier: Apache-2.0

#include <zephyr/kernel.h>
#include <zephyr/device.h>
#include <zephyr/drivers/led_strip.h>
#include <zephyr/logging/log.h>
#include "led_rbg.h"
#include <stdint.h>

LOG_MODULE_REGISTER(led_rbg, LOG_LEVEL_INF);

static const struct device *led_strip = DEVICE_DT_GET(DT_CHOSEN(zephyr_led_strip));

void test_led(void)
{
	LOG_INF("Running RGB LED test");
	LOG_INF("...");

	struct led_rgb pixel = {
		.r = 0x00,
		.g = 0x00,
		.b = 0x00,
	};

	if (!device_is_ready(led_strip)) {
		return;
	}

	for (int i = 0; i <= 255; i++) {
		pixel.r = i;
		pixel.g = 0;
		pixel.b = 0;
		int ret = led_strip_update_rgb(led_strip, &pixel, 1);
		k_sleep(K_MSEC(10));
		if (ret < 0) {
			LOG_ERR("RGB=(%d,%d,%d) ret=%d", pixel.r, pixel.g, pixel.b, ret);
		}
	}

	for (int i = 0; i <= 255; i++) {
		pixel.r = 0;
		pixel.g = i;
		pixel.b = 0;
		int ret = led_strip_update_rgb(led_strip, &pixel, 1);
		k_sleep(K_MSEC(10));
		if (ret < 0) {
			LOG_ERR("RGB=(%d,%d,%d) ret=%d", pixel.r, pixel.g, pixel.b, ret);
		}
	}

	for (int i = 0; i <= 255; i++) {
		pixel.r = 0;
		pixel.g = 0;
		pixel.b = i;
		int ret = led_strip_update_rgb(led_strip, &pixel, 1);
		k_sleep(K_MSEC(10));
		if (ret < 0) {
			LOG_ERR("RGB=(%d,%d,%d) ret=%d", pixel.r, pixel.g, pixel.b, ret);
		}
	}
}
```

## src/led_rbg.h
```c
// Copyright (c) 2026 ID8 Engineering AB
// SPDX-License-Identifier: Apache-2.0

#ifndef LED_RBG_H_
#define LED_RBG_H_

void led_test(void);

#endif /* LED_RBG_H_ */
```

## src/lte.c
```c
// Copyright (c) 2026 ID8 Engineering AB
// SPDX-License-Identifier: Apache-2.0

#include "zephyr/logging/log_core.h"
#include <zephyr/kernel.h>
#include <zephyr/logging/log.h>

#include <modem/lte_lc.h>
#include <modem/nrf_modem_lib.h>

LOG_MODULE_REGISTER(LTE, LOG_LEVEL_INF);

void test_lte()
{
	int err;

	LOG_INF("Running LTE test");
	LOG_INF("...");

	err = nrf_modem_lib_init();
	if (err < 0) {
		LOG_ERR("Modem init failed: %d", err);
		return;
	}

	err = lte_lc_connect();
	if (err < 0) {
		LOG_ERR("LTE connect failed: %d", err);
		return;
	}

	LOG_INF("LTE connected");
	LOG_INF("LTE test done");
}
```

## src/lte.h
```c
// Copyright (c) 2026 ID8 Engineering AB
// SPDX-License-Identifier: Apache-2.0

#ifndef LTE_H_
#define LTE_H_

void test_lte(void);

#endif /* LTE_H_ */
```

## src/mikroBUS_CAN.c
```c
// Copyright (c) 2026 ID8 Engineering AB
// SPDX-License-Identifier: Apache-2.0

#include <errno.h>
#include <zephyr/kernel.h>
#include <zephyr/device.h>
#include <zephyr/drivers/can.h>
#include <zephyr/logging/log.h>
#include "mikroBUS_CAN.h"

LOG_MODULE_REGISTER(mikroBUS_CAN, LOG_LEVEL_INF);

#if defined(CONFIG_SEVEN_TEST_CAN_MIKROBUS)

static const struct device *can_dev = DEVICE_DT_GET(DT_CHOSEN(zephyr_canbus));

CAN_MSGQ_DEFINE(can_rx_msgq, 10);

void test_mikroBUS_CAN(void)
{
	const struct can_filter filter = {
		.flags = 0,
		.id = 0,
		.mask = 0,
	};
	struct can_frame frame;
	int64_t end_time;
	int filter_id;
	int ret;

	LOG_INF("Starting mikroBUS CAN test");
	LOG_INF("Listening for CAN frames for 10 seconds");
	LOG_INF("...");

	if (!device_is_ready(can_dev)) {
		LOG_ERR("CAN device %s is not ready", can_dev->name);
		return;
	}

	ret = can_set_bitrate(can_dev, 250000);
	if (ret < 0) {
		LOG_ERR("Failed to set CAN bitrate: %d", ret);
		return;
	}

	ret = can_start(can_dev);
	if (ret < 0) {
		LOG_ERR("Failed to start CAN controller: %d", ret);
		return;
	}

	filter_id = can_add_rx_filter_msgq(can_dev, &can_rx_msgq, &filter);
	if (filter_id < 0) {
		LOG_ERR("Failed to add CAN RX filter: %d", filter_id);
		return;
	}

	end_time = k_uptime_get() + 10000;

	while (k_uptime_get() < end_time) {
		int64_t remaining = end_time - k_uptime_get();

		ret = k_msgq_get(&can_rx_msgq, &frame, K_MSEC(remaining));
		if (ret == -EAGAIN) {
			break;
		}
		if (ret < 0) {
			LOG_ERR("Failed to read CAN frame: %d", ret);
			break;
		}

		LOG_INF("CAN id=0x%x dlc=%u data=%02x %02x %02x %02x %02x %02x %02x %02x", frame.id,
			frame.dlc, frame.data[0], frame.data[1], frame.data[2], frame.data[3],
			frame.data[4], frame.data[5], frame.data[6], frame.data[7]);
	}

	can_remove_rx_filter(can_dev, filter_id);
	LOG_INF("mikroBUS CAN test done");
}

#endif
```

## src/mikroBUS_CAN.h
```c
// Copyright (c) 2026 ID8 Engineering AB
// SPDX-License-Identifier: Apache-2.0

#ifndef MIKROBUS_CAN_H_
#define MIKROBUS_CAN_H_

void test_mikroBUS_CAN(void);

#endif /* MIKROBUS_CAN_H_ */
```
