/*
 * Copyright (c) 2023 Nordic Semiconductor ASA
 *
 * SPDX-License-Identifier: Apache-2.0
 */

/dts-v1/;
#include <nordic/nrf9151ns_laca.dtsi>
#include "seven_nrf9151_common-pinctrl.dtsi"
#include "seven_nrf9151_common.dtsi"

/ {
	model = "Seven nRF9151 Non-Secure";
	compatible = "id8,seven-nrf9151-ns";

	chosen {
		zephyr,flash = &flash0;
		zephyr,sram = &sram0_ns_app;
		zephyr,code-partition = &slot0_ns_partition;
	};
};

/* Disable UART1, because it is used by default in TF-M */
&uart1 {
	status = "disabled";
};
