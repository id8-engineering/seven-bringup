## boards/id8/seven_nrf9151/Kconfig.seven
```kconfig
# Seven nRF9151 board configuration

# Copyright (c) 2023 Nordic Semiconductor ASA
# SPDX-License-Identifier: Apache-2.0

config BOARD_SEVEN
	select SOC_NRF9151_LACA
```
